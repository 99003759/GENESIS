VERSION ""

NS_ :

BS_:

BU_:

BO_ 264 SunroofMsg: 2 Vector__XXX
 SG_ Sunroof : 0|16@1+ (0.1,0) [0|65535] "" Vector__XXX

BA_DEF_  "BusType" STRING ;
BA_DEF_DEF_  "BusType" "CAN";
