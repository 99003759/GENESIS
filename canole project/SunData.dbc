VERSION ""

NS_ :

BS_:

BU_:
VAL_TABLE_ Vt_Obstarct 1 "There is an obstract" 0 "No Obstract" ;

BO_ 262 ObstractMsg: 1 Vector__XXX
 SG_ Obstract : 0|1@1+ (1,0) [0|1] "" Vector__XXX

BO_ 263 Sunroof: 2 Vector__XXX
 SG_ SunroofStatus : 0|16@1+ (0.1,0) [0|65535] "" Vector__XXX

EV_ sunroofOp: 0 [0|100] "" 0 1 DUMMY_NODE_VECTOR0 Vector__XXX;

VAL_ 262 Obstract 1 "There is an obstract" 0 "No Obstract" ;
